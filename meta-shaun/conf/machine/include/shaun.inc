## meta-shaun/conf/machine/include/shaun.inc
```bitbake
VIRTUAL-RUNTIME_obmc-host-state-manager = "x86-power-control"
VIRTUAL-RUNTIME_obmc-chassis-state-manager = "x86-power-control"
VIRTUAL-RUNTIME_obmc-discover-system-state = "x86-power-control"

VIRTUAL-RUNTIME_obmc-inventory-manager = "entity-manager"
VIRTUAL-RUNTIME_obmc-sensors-hwmon = "dbus-sensors"

PREFERRED_PROVIDER_virtual/phosphor-led-manager-config-native = "led-manager-config-native"
```

## meta-shaun/meta-k880g6/conf/layer.conf
```bitbake
# We have a conf and classes directory, add to BBPATH
BBPATH .= ":${LAYERDIR}"

# We have recipes-* directories, add to BBFILES
BBFILES += "${LAYERDIR}/recipes-*/*/*.bb \
            ${LAYERDIR}/recipes-*/*/*.bbappend"

BBFILE_COLLECTIONS += "k880g6-layer"
BBFILE_PATTERN_k880g6-layer = "^${LAYERDIR}/"

LAYERSERIES_COMPAT_k880g6-layer = "langdale mickledore"
```

## meta-shaun/meta-seadra/conf/machine/seadra.conf
```bitbake
KERNEL_DEVICETREE = "aspeed-kernal-shaun-seadra.dtb"

UBOOT_MACHINE = "evb-ast2500_defconfig"
UBOOT_DEVICETREE = "ast2500-uboot-shaun-seadra"

require conf/machine/include/ast2500.inc
require conf/machine/include/obmc-evb-common.inc
require conf/machine/include/intel.inc
require conf/machine/include/shaun.inc

SERIAL_CONSOLES = "115200;ttyS4"

FLASH_SIZE = "65536"
```
